## drivers/Kconfig
```kconfig
# Copyright (c) 2024 Eve Redero
# SPDX-License-Identifier: Apache-2.0

menu "Drivers"
rsource "nrf24l01/Kconfig"
endmenu
```

## drivers/cc2500/Kconfig
```kconfig
menuconfig CC2500
	bool "TI CC2500 remote control support"

if CC2500

module = CC2500
module-str = cc2500
source "subsys/logging/Kconfig.template.log_config"

config CC2500_INIT_PRIORITY
	int "Lock init priority"
	default 90
	help
	  CC2500 initialization priority.

config CC2500_TRIGGER
	bool "NRF24 trigger with irq gpio"
	depends on CC2500
	help
	  When enabled, the CC2500 read is triggered by irq gpio and
	  not by polling.

config CC2500_READ_TIMEOUT
	int "Timout for read operation"
	depends on CC2500_TRIGGER
	default 1000
	help
	  CC2500 timeout for reading, in ms.

config CC2500_WRITE_TIMEOUT
	int "Timout for write operation"
	depends on CC2500_TRIGGER
	default 100
	help
	  CC2500 timeout for writing, in ms.

endif # CC2500
```

## drivers/nrf24l01/Kconfig
```kconfig
menuconfig NRF24L01
	bool "NRF24 remote control support"

if NRF24L01

module = NRF24L01
module-str = nrf24l01
source "subsys/logging/Kconfig.template.log_config"

config NRF24L01_INIT_PRIORITY
	int "Lock init priority"
	default 90
	help
	  nRF24 initialization priority.

config NRF24L01_TRIGGER
	bool "NRF24 trigger with irq gpio"
	depends on NRF24L01
	help
	  When enabled, the NRF24L01 read is triggered by irq gpio and
	  not by polling.

config NRF24L01_READ_TIMEOUT
	int "Timout for read operation"
	depends on NRF24L01_TRIGGER
	default 1000
	help
	  nRF24 timeout for reading, in ms.

endif # NRF24L01
```

## dts/bindings/nrf24/nordic,nrf24l01.yaml
```yaml
# Copyright (c) 2022 Nordic Semiconductor ASA
# SPDX-License-Identifier: Apache-2.0

description: |
  nRF24L01 is a 2.4GHz wireless remote control module.

compatible: "nordic,nrf24l01"

include: [base.yaml, spi-device.yaml]

properties:
  reg:
    required: true

  ce-gpios:
    type: phandle-array
    required: true
    description: |
      Chip Enable GPIO (active high). It is used to activate the chip RX or TX mode. If not configured, the driver will use three-wires behaviour and multiplex with the SPI CSN signal.

  irq-gpios:
    type: phandle-array
    required: true
    description: |
      Chip Interrupt signal (active low). If not selected, do not use interrupts.

  addr-width:
    type: int
    required: false
    description: |
      Message address field width, should be 3, 4 or 5 bytes. Default is 5.
    default: 5

  channel-frequency:
    type: int
    required: true
    description: |
      Channel selection, from 0 to 126. 0 is 2400MHz, each channel is 1MHz wide and 126 is 2526MHz. Default is 16.
    default: 16

  data-rate-2mbps:
    type: boolean
    required: false
    description: |
      Change data rate to 2Mbps. By default the device uses 1Mbps.

  rf-power-attenuation:
    type: int
    required: true
    description: |
      RF power attenuation in dB, choose 0, 6, 12 or 18 for 0, -6dB, -12dB or -18dB.
      - ATTEN_0: -0 dB
      - ATTEN_6: -6 dB
      - ATTEN_12: -12 dB
      - ATTEN_18: -18 dB
      enum:
        - "ATTEN_0"
        - "ATTEN_6"
        - "ATTEN_12"
        - "ATTEN_18"

  lna-gain:
    type: boolean
    required: false
    description: |
      Low noise amplifier activation, allows to reduce consumption in RX mode while sacrificing 1.5dB gain. False by default.

  crc-encoding-twobytes:
    type: boolean
    required: false
    description: |
      CRC encoding scheme, false for one byte, true for two bytes.

  tx-address:
    type: uint8-array
    required: true
    description: |
      Transmit channel address, should have a length of addr-width

  dynamic-payload:
    type: boolean
    required: false
    description: |
      Whether NRF24 dynamic payload length is enabled or not. False by default.

  payload-fixed-size:
    type: int
    required: false
    description: |
      Fixed payload side for transmit and all receive channels. Should be
      the same for RX and TX side. 32 by default.

  payload-ack:
    type: boolean
    required: false
    description: |
      NRF24 payload with ACK. False by default.

  payload-crc:
    type: boolean
    required: false
    description: |
      NRF24 payload with CRC. False by default.

  rx-datapipes-number:
    type: int
    required: false
    description: |
      Number of enabled RX data pipe numbers. 1 by default.
    default: 1

  rx-datapipe0-address:
    type: uint8-array
    required: false
    default: [0xe7, 0xe7, 0xe7, 0xe7, 0xe7]
    description: |
      RX data pipe 0 address.
      Should have a length of addr-width.

  rx-datapipe1-address:
    type: uint8-array
    required: false
    default: [0xc2, 0xc2, 0xc2, 0xc2, 0xc2]
    description: |
      RX data pipe 1 address.
      Should have a length of addr-width.

  rx-datapipe2-address:
    type: int
    required: false
    default: 0x02
    description: |
      RX data pipe 2 address LSB.
      All MSB bytes are equal to rx-datapipe1-address.

  rx-datapipe3-address:
    type: int
    required: false
    default: 0x03
    description: |
      RX data pipe 3 address LSB.
      All MSB bytes are equal to rx-datapipe1-address.

  rx-datapipe4-address:
    type: int
    required: false
    default: 0x04
    description: |
      RX data pipe 4 address LSB.
      All MSB bytes are equal to rx-datapipe1-address.

  rx-datapipe5-address:
    type: int
    required: false
    default: 0x05
    description: |
      RX data pipe 5 address LSB.
      All MSB bytes are equal to rx-datapipe1-address.

  rx-datapipes-dynamic-payload:
    type: array
    required: false
    description: |
      List of the RX data pipes dynamic payload activation booleans (0 or 1)
      Should have length rx-datapipe-number.
```

## dts/bindings/propy_radio/ti,cc2500.yaml
```yaml
# Copyright (c) 2024 Eve Redero
# SPDX-License-Identifier: Apache-2.0

description: |
  CC2500 is a 2.4GHz wireless remote control module.

compatible: "ti,cc2500"

include: [base.yaml, spi-device.yaml]

properties:
  reg:
    required: true

  conf-array:
    type: uint8-array
    description: |
      Configuration values from 0x07 to 0x2E.
      By default, device keeps its default conf values.

  irq-gpios:
    type: phandle-array
    required: false
    description: |
      Chip parametric GPIO 0 or 2. Default is GPIO 0, use use-gpio-2-as-irq to select GPIO 2 instead.

  use-gpio-2-as-irq:
    type: boolean
    required: false
    description: |
      Use GPIO 2 instead of GPIO 0 as IRQ input pin.

  payload-crc:
    type: boolean
    required: false
    description: |
      Use payload CRC. Default true.
```

## tests/driver/nrf24l01/testcase.yaml
```yaml
common:
  tags: extensibility
tests:
  driver.nrf24l01.nucleo:
    integration_platforms:
      - nucleo_f756zg
    extra_args: DTC_OVERLAY_FILE="${CMAKE_CURRENT_SOURCE_DIR}/../../../app/boards/nucleo_f756zg.overlay"
  driver.nrf24l01.nrf52:
    integration_platforms:
      - nrf52dk/nrf52832
    extra_args: DTC_OVERLAY_FILE="${CMAKE_CURRENT_SOURCE_DIR}/../../../app/boards/nrf52dk_nrf52832.overlay"
  driver.nrf24l01.esp32:
    integration_platforms:
      - esp32_devkitc_wroom/esp32/procpu
    extra_args: DTC_OVERLAY_FILE="${CMAKE_CURRENT_SOURCE_DIR}/../../../app/boards/esp32_devkitc_wroom.overlay"
```

## west.yml
```yaml
# Copyright (c) 2021 Nordic Semiconductor ASA
# SPDX-License-Identifier: Apache-2.0

manifest:
  self:
    west-commands: scripts/west-commands.yml

  remotes:
    - name: zephyrproject-rtos
      url-base: https://github.com/zephyrproject-rtos

  projects:
    - name: zephyr
      remote: zephyrproject-rtos
      revision: c33743ef955b066a5711097a6b0e184de1519b7f #v3.6.0-rc3
      import:
        # By using name-allowlist we can clone only the modules that are
        # strictly needed by the application.
        name-allowlist:
          - cmsis      # required by the ARM port
          - hal_nordic # required by the nRF52 board (Nordic based)
          - hal_stm32  # required by the nucleo board (STM32 based)
          - hal_espressif  # required by the esp32 board (ESP32 based)
```

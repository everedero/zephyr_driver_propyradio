## CMakeLists.txt
```
# Copyright (c) 2021, Legrand North America, LLC.
# SPDX-License-Identifier: Apache-2.0

cmake_minimum_required(VERSION 3.20.0)
set(SYSCALL_INCLUDE_DIRS "${CMAKE_CURRENT_SOURCE_DIR}/../../../include")
# Use the project local board root folder
set(BOARD_ROOT "${CMAKE_CURRENT_SOURCE_DIR}/../../../app")

find_package(Zephyr REQUIRED HINTS $ENV{ZEPHYR_BASE})

project(app LANGUAGES C)

target_sources(app PRIVATE src/main.c)
```

## prj.conf
```kconfig
CONFIG_ZTEST=y
CONFIG_SPI=y
CONFIG_NRF24L01=y
```

## src/main.c
```c
/*
* Copyright (c) 2024 Eve Redero
* SPDX-License-Identifier: Apache-2.0
*/

/*
* @file test nrf24l01 driver
*
* This suite verifies that the driver builds correctly
* on selected target
*/

#include <zephyr/ztest.h>

#include <zephyr/kernel.h>
#include <zephyr/devicetree.h>

#include <app/drivers/propy_radio.h>
#include <zephyr/logging/log.h>
LOG_MODULE_REGISTER(main, CONFIG_NRF24L01_LOG_LEVEL);

#if !DT_NODE_EXISTS(DT_NODELABEL(radio0))
#error "whoops, node label radio0 not found"
#endif

ZTEST(nrf24l01, test_get_value)
{
	static const struct device *nrf24 = DEVICE_DT_GET(DT_NODELABEL(radio0));
	zassert_equal(1, 1, "Dummy test fail");
    zassert_not_null(nrf24, "Device pointer is null");
    zassert_not_null(nrf24->name, "Device name is null");
}

ZTEST_SUITE(nrf24l01, NULL, NULL, NULL, NULL, NULL);
```

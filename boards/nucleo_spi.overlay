
&spi1 {
	pinctrl-0 = <&spi1_sck_pb3 &spi1_miso_pb4 &spi1_mosi_pb5>;// &spi1_nss_pa4>;
	pinctrl-names = "default";
	cs-gpios = <&gpioa 4 (GPIO_ACTIVE_LOW | GPIO_PULL_UP)>;
	//clock-frequency = <8000000>; // Max 8 Mbps for SPI
	clock-frequency = <50000>; // Max 8 Mbps for SPI
	status = "okay";

	radio0: nrf24@0 {
		reg = <0>;
		compatible = "nordic,nrf24l01";
		status = "okay";
		ce-gpios = <&gpiod 15 GPIO_ACTIVE_HIGH>;
		irq-gpios = <&gpiod 14 GPIO_ACTIVE_LOW>;
		channel-frequency = <16>;
		rf-power-attenuation = <18>;
		lna-gain;
		tx-address = [e7 e7 e7 e7 e7];
		rx-datapipes-number = <2>;
		rx-datapipe0-address = [e7 e7 e7 e7 e7];
		rx-datapipe1-address = [de ad de ad da];
		rx-datapipes-fixed-size-payload = <16 32>;
	};
};
